; --------------------------------------------------------------------------------
; @Title: FreeRTOS Demo for TRACE32 OS Awareness
; @Description:
;
;   This batchfile loads all necessary files to demonstrate
;   the OS Awareness for FreeRTOS on CortexM3.
;
; @Keywords: Awareness, FreeRTOS, RTOS
; @Author: LinJiajun
; @Copyright: (C)
; --------------------------------------------------------------------------------


SCREEN.ON
AREA.RESet
;WinPAGE.RESet
;WinCLEAR
;WinPOS 0. 27. 63. 7. 0. 0. W006
;AREA.view

; Debugger reset
PRINT "Resetting..."
RESet
SYStem.RESet

; Initializing Debugger
PRINT "Set kernel architecture..."
SYStem.CPU CortexM3
SYStem.Up

; load elf and binary files
PRINT "Load elf and bin files..."
Data.LOAD.Elf    ..\..\valid_file\xinyiNBSoc.elf
DATA.LOAD.BINARY ..\..\valid_file\sram_M3_20000000.bin   0x20000000  /noclear


;set up an AREA window named Heap_List
;AREA.Create Heap_List

;clear area
;AREA.CLEAR Heap_List

;write all outputs to the AREA window, and also to the file heap.log
;the file is not necessary
;AREA.OPEN Heap_List heap.log

;display the AREA window in TRACE32
;AREA.view Heap_List

;close the file heap.log
;AREA.CLOSE Heap_List heap.log


;myWin01 is a user-defined window name
;WinPOS , , 70. 15. , , , myWin01

;The user-defined window default size takes effect again
;Trace.List



; initialize RTOS support
PRINT "Initializing FreeRTOS support..."
;TASK.CONFIG FreeRTOS           ; load FreeRTOS awareness (freertos.t32)
MENU.ReProgram ./FreeRTOS.men   ; load FreeRTOS menu (freertos.men)
;HELP.FILTER.Add rtosfreertos   ; add FreeRTOS awareness manual to filtered help
; analyze current stack
;DO ./FreeRTOS_MainStack.cmm
DODECRYPT "LinJiajun"  ./FreeRTOS_MainStack.t32

PRINT "Mian script end"